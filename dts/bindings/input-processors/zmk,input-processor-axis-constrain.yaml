## dts/bindings/input-processors/zmk,input-processor-axis-constrain.yaml
```yaml
description: |
  Input processor that constrains trackball movement to a single axis.
  Once movement exceeds the threshold, only horizontal or vertical axis
  is allowed based on the initial movement direction.

compatible: "zmk,input-processor-axis-constrain"

# include: ip_zero_param.yaml

properties:
  "#input-processor-cells":
    type: int
    const: 0
    description: "Number of cells in input processor specifier"

properties:
  axis-lock-threshold:
    type: int
    default: 5
    description: |
      Minimum movement required to determine axis direction.
      The axis is locked once cumulative movement exceeds this value.

  release-after-ms:
    type: int
    default: 0
    description: |
      Time in milliseconds before axis lock is released.
      Set to 0 for immediate release (no sticky behavior).

  track-remainders:
    type: boolean
```
